## LCD_blink/main/Kconfig.projbuild
```kconfig
menu "LCD Blink Configuration"

    config LCD_BLINK_PERIOD_MS
        int "LCD color blink period in ms"
        range 10 3600000
        default 1000
        help
            Delay between full-screen LCD color changes.

endmenu
```

## LCD_color_audio/main/Kconfig.projbuild
```kconfig
menu "LCD Color Audio Configuration"

    config LCD_AUDIO_MODE_HOLD_MS
        int "Mode hold time in ms"
        range 500 3600000
        default 2500
        help
            How long each LCD color and speaker tone mode stays active.

    config LCD_AUDIO_TONE_MS
        int "Tone duration in ms"
        range 100 5000
        default 700
        help
            Duration of each speaker tone.

    config LCD_AUDIO_VOLUME
        int "Speaker volume"
        range 0 100
        default 70
        help
            Output volume passed to esp_codec_dev_set_out_vol().

    config SPARKBOT_AUDIO_I2C_NUM
        int "Audio I2C port"
        range 0 1
        default 0
        help
            I2C controller used to configure the ES8311 codec.

    config SPARKBOT_AUDIO_I2S_NUM
        int "Audio I2S port"
        range 0 1
        default 0
        help
            I2S controller used to send PCM samples to the ES8311 codec.

endmenu
```

## LCD_color_audio/sdkconfig.defaults.esp32s3
```kconfig
CONFIG_LCD_AUDIO_MODE_HOLD_MS=2500
CONFIG_LCD_AUDIO_TONE_MS=700
CONFIG_LCD_AUDIO_VOLUME=70
CONFIG_SPARKBOT_AUDIO_I2C_NUM=0
CONFIG_SPARKBOT_AUDIO_I2S_NUM=0
```

## LCD_color_frequency/main/Kconfig.projbuild
```kconfig
menu "LCD Color Frequency Configuration"

    config LCD_COLOR_HOLD_MS
        int "Color hold time in ms"
        range 500 3600000
        default 4000
        help
            How long each color and backlight frequency mode stays active.

    config LCD_MIN_HALF_PERIOD_MS
        int "Minimum backlight half-period in ms"
        range 10 1000
        default 40
        help
            Lower limit for the software generated backlight toggle half-period.
            This protects the task from trying to blink faster than the GPIO
            loop should run.

endmenu
```

## LCD_color_speech/main/Kconfig.projbuild
```kconfig
menu "LCD Color Speech Configuration"

    config LCD_COLOR_SPEECH_HOLD_MS
        int "Color hold time in ms"
        range 500 3600000
        default 2500
        help
            Delay after each color name is displayed and spoken.

    config LCD_COLOR_SPEECH_VOLUME
        int "Speaker volume"
        range 0 100
        default 75
        help
            Output volume passed to esp_codec_dev_set_out_vol().

    config SPARKBOT_AUDIO_I2C_NUM
        int "Audio I2C port"
        range 0 1
        default 0
        help
            I2C controller used to configure the ES8311 codec.

    config SPARKBOT_AUDIO_I2S_NUM
        int "Audio I2S port"
        range 0 1
        default 0
        help
            I2S controller used to send PCM samples to the ES8311 codec.

endmenu
```

## LCD_color_speech/sdkconfig.defaults
```kconfig
CONFIG_IDF_TARGET="esp32s3"
CONFIG_LCD_COLOR_SPEECH_HOLD_MS=2500
CONFIG_LCD_COLOR_SPEECH_VOLUME=75
CONFIG_SPARKBOT_AUDIO_I2C_NUM=0
CONFIG_SPARKBOT_AUDIO_I2S_NUM=0
CONFIG_COMPILER_OPTIMIZATION_NONE=y
```

## LCD_face_cycle/main/Kconfig.projbuild
```kconfig
menu "LCD Face Cycle Configuration"

    config LCD_FACE_CYCLE_PERIOD_MS
        int "Expression switch period in ms"
        default 1500
        range 200 3600000
        help
            Delay between two full-screen face scenes.

endmenu
```

## LCD_face_touch_control/main/Kconfig.projbuild
```kconfig
menu "LCD Face Touch Control"

    config LCD_FACE_TOUCH_LONGPRESS_MS
        int "Touch long-press threshold in ms"
        default 2000
        range 500 10000

endmenu
```

## LCD_face_touch_control/sdkconfig.defaults.esp32s3
```kconfig
CONFIG_IDF_TARGET="esp32s3"
CONFIG_ESPTOOLPY_FLASHMODE_DIO=y
CONFIG_ESPTOOLPY_FLASHFREQ_80M=y
CONFIG_ESPTOOLPY_FLASHSIZE_16MB=y

CONFIG_SPIRAM=y
CONFIG_SPIRAM_MODE_OCT=y
CONFIG_SPIRAM_FETCH_INSTRUCTIONS=y
CONFIG_SPIRAM_RODATA=y
CONFIG_SPIRAM_SPEED_80M=y
CONFIG_SPIRAM_MALLOC_ALWAYSINTERNAL=64
CONFIG_SPIRAM_ALLOW_BSS_SEG_EXTERNAL_MEMORY=y
CONFIG_SPIRAM_ALLOW_NOINIT_SEG_EXTERNAL_MEMORY=y

CONFIG_ESP_DEFAULT_CPU_FREQ_MHZ_240=y
CONFIG_FREERTOS_HZ=1000
CONFIG_FREERTOS_TIMER_TASK_STACK_DEPTH=4096
CONFIG_LIBC_NEWLIB_NANO_FORMAT=y

CONFIG_LCD_FACE_TOUCH_LONGPRESS_MS=2000
```

## LCD_face_voice_control/main/Kconfig.projbuild
```kconfig
menu "LCD Face Voice Control"

    config LCD_FACE_VOICE_MIC_GAIN
        int "Microphone input gain"
        default 30
        range 0 45

    config LCD_FACE_VOICE_WAKE_MODE_90
        bool "Use factory-demo wake mode 90"
        default y

    config LCD_FACE_VOICE_COMMAND_TIMEOUT_MS
        int "Multinet command recognition timeout in ms"
        default 5760
        range 1000 20000

    config LCD_FACE_VOICE_MN_THRESHOLD_PERCENT
        int "Multinet command threshold percent, 0 uses model default"
        default 0
        range 0 99

endmenu
```

## LCD_face_voice_control/sdkconfig.defaults
```kconfig
CONFIG_IDF_TARGET="esp32s3"
CONFIG_ESPTOOLPY_FLASHMODE_DIO=y
CONFIG_ESPTOOLPY_FLASHFREQ_80M=y
CONFIG_ESPTOOLPY_FLASHSIZE_16MB=y
CONFIG_PARTITION_TABLE_CUSTOM=y
CONFIG_PARTITION_TABLE_CUSTOM_FILENAME="partitions.csv"

CONFIG_SPIRAM=y
CONFIG_SPIRAM_MODE_OCT=y
CONFIG_SPIRAM_FETCH_INSTRUCTIONS=y
CONFIG_SPIRAM_RODATA=y
CONFIG_SPIRAM_SPEED_80M=y
CONFIG_SPIRAM_MALLOC_ALWAYSINTERNAL=64
CONFIG_SPIRAM_ALLOW_BSS_SEG_EXTERNAL_MEMORY=y
CONFIG_SPIRAM_ALLOW_NOINIT_SEG_EXTERNAL_MEMORY=y

CONFIG_ESP_DEFAULT_CPU_FREQ_MHZ_240=y
CONFIG_FREERTOS_HZ=1000
CONFIG_FREERTOS_TIMER_TASK_STACK_DEPTH=4096
CONFIG_LIBC_NEWLIB_NANO_FORMAT=y

CONFIG_USE_MULTINET=y
CONFIG_SR_WN_WN9_HILEXIN=y
CONFIG_SR_MN_CN_MULTINET7_QUANT=y
CONFIG_SR_MN_EN_NONE=y

CONFIG_CODEC_ES8311_SUPPORT=y
CONFIG_SPARKBOT_AUDIO_I2C_NUM=0
CONFIG_SPARKBOT_AUDIO_I2S_NUM=0
CONFIG_LCD_FACE_VOICE_MIC_GAIN=30
CONFIG_LCD_FACE_VOICE_WAKE_MODE_90=y
CONFIG_LCD_FACE_VOICE_COMMAND_TIMEOUT_MS=5760
CONFIG_LCD_FACE_VOICE_MN_THRESHOLD_PERCENT=0
```

## LCD_text_scroll/main/Kconfig.projbuild
```kconfig
menu "LCD Text Scroll Configuration"

    config LCD_TEXT_SCROLL_FRAME_MS
        int "LCD text scroll frame interval in ms"
        range 10 1000
        default 40
        help
            Delay between marquee animation frames.

    config LCD_TEXT_SCROLL_PIXELS_PER_FRAME
        int "LCD text scroll pixels per frame"
        range 1 16
        default 2
        help
            Horizontal movement distance for each marquee frame.

endmenu
```

## LCD_text_scroll/sdkconfig.defaults
```kconfig
CONFIG_IDF_TARGET="esp32s3"
CONFIG_LCD_TEXT_SCROLL_FRAME_MS=40
CONFIG_LCD_TEXT_SCROLL_PIXELS_PER_FRAME=2
CONFIG_COMPILER_OPTIMIZATION_NONE=y
```

## LCD_text_switch/main/Kconfig.projbuild
```kconfig
menu "LCD Text Switch Configuration"

    config LCD_TEXT_SWITCH_PERIOD_MS
        int "LCD text switch period in ms"
        range 100 3600000
        default 1000
        help
            Delay between the HelloWorld and Chinese text screens.

endmenu
```

## LCD_text_switch/sdkconfig.defaults
```kconfig
CONFIG_IDF_TARGET="esp32s3"
CONFIG_LCD_TEXT_SWITCH_PERIOD_MS=1000
CONFIG_COMPILER_OPTIMIZATION_NONE=y
```

## LCD_weather/main/Kconfig.projbuild
```kconfig
menu "Example Configuration"

    config QWEATHER_REQUEST_KEY
        string "QWEATHER REQUEST KEY"
        default "key"
        help
            Get weather information from QWeather server

    config QWEATHER_API_HOST
        string "QWEATHER API HOST"
        default "your_api_host"
        help
            QWeather API Host from the QWeather console, for example abc1234xyz.def.qweatherapi.com

endmenu
```

## LCD_weather_voice_control/components/weather_service/Kconfig
```kconfig
menu "Weather Service"

    config WEATHER_WIFI_SSID
        string "Wi-Fi SSID"
        default ""

    config WEATHER_WIFI_PASSWORD
        string "Wi-Fi password"
        default ""

    config WEATHER_QWEATHER_KEY
        string "QWeather API key"
        default ""
        help
            Get a key from https://console.qweather.com/

    config WEATHER_LOCATION
        string "QWeather location"
        default "101020100"
        help
            QWeather LocationID or longitude,latitude, for example 101020100 or 121.47,31.23.

    config WEATHER_LANGUAGE
        string "QWeather language"
        default "en"
        help
            Use en for this built-in bitmap font UI. zh works for API data but this UI cannot draw Chinese glyphs.

    config WEATHER_REFRESH_INTERVAL_MIN
        int "Weather refresh interval in minutes"
        default 60
        range 5 1440

endmenu
```

## LCD_wifi_web_config/main/Kconfig.projbuild
```kconfig
menu "SparkBot Web WiFi Config"

    config SPARKBOT_WEB_CONFIG_AP_SSID
        string "SoftAP SSID for WiFi setup"
        default "SparkBot-Config"

    config SPARKBOT_WEB_CONFIG_AP_PASSWORD
        string "SoftAP password for WiFi setup"
        default "12345678"
        help
            Leave empty to create an open setup network. Use at least 8
            characters when a password is configured.

    config SPARKBOT_WEB_CONFIG_AP_CHANNEL
        int "SoftAP channel"
        default 6
        range 1 13

    config SPARKBOT_WEB_CONFIG_MAX_STA_RETRY
        int "Station connect retry count"
        default 8
        range 0 30

    config SPARKBOT_WEB_CONFIG_HTTP_PORT
        int "HTTP server port"
        default 80
        range 1 65535

endmenu
```

## TraeDemo/lcd_blink/main/Kconfig.projbuild
```kconfig
menu "LCD Blink Configuration"

    config LCD_BLINK_PERIOD_MS
        int "LCD blink period (ms)"
        range 10 3600000
        default 1000
        help
            Period in milliseconds for the LCD backlight blink cycle.
            One period consists of backlight ON (half period) and OFF (half period).
            For example, a value of 1000 means 500 ms on, 500 ms off.

endmenu
```

## sparkbot_voice_chassis/components/sparkbot_audio/Kconfig
```kconfig
menu "SparkBot Audio"

    config SPARKBOT_AUDIO_I2C_NUM
        int "I2C peripheral index"
        default 0
        range 0 1

    config SPARKBOT_AUDIO_I2S_NUM
        int "I2S peripheral index"
        default 0
        range 0 1

endmenu
```

## sparkbot_voice_chassis/main/Kconfig.projbuild
```kconfig
menu "SparkBot Voice Chassis"

    config SPARKBOT_VOICE_CHASSIS_MOVE_MS
        int "Forward/backward movement pulse in ms"
        default 550
        range 100 5000

    config SPARKBOT_VOICE_CHASSIS_TURN_MS
        int "Left/right turn pulse in ms"
        default 650
        range 100 5000

    config SPARKBOT_VOICE_CHASSIS_MIC_GAIN
        int "Microphone input gain"
        default 35
        range 0 45

    config SPARKBOT_VOICE_CHASSIS_WAKE_MODE_90
        bool "Use factory-demo wake mode 90"
        default y

    config SPARKBOT_VOICE_CHASSIS_WAKE_PROMPT_ENABLE
        bool "Play wake prompt tone"
        default n

    config SPARKBOT_VOICE_CHASSIS_LCD_ENABLE
        bool "Enable LCD status UI"
        default y

    config SPARKBOT_VOICE_CHASSIS_WAKE_PROMPT_DELAY_MS
        int "Wake prompt delay before listening"
        default 120
        range 0 500

    config SPARKBOT_VOICE_CHASSIS_COMMAND_WAIT_MS
        int "Wake-to-command speech wait in ms"
        default 8000
        range 1000 20000

    config SPARKBOT_VOICE_CHASSIS_COMMAND_TIMEOUT_MS
        int "Multinet command recognition timeout in ms"
        default 5760
        range 1000 20000

    config SPARKBOT_VOICE_CHASSIS_COMMAND_SETTLE_MS
        int "Quiet gap before accepting a command in ms"
        default 400
        range 0 2000

    config SPARKBOT_VOICE_CHASSIS_COMMAND_VAD_GATE
        bool "Wait for VAD speech before feeding MultiNet"
        default n

    config SPARKBOT_VOICE_CHASSIS_MN_THRESHOLD_PERCENT
        int "Multinet command threshold percent, 0 uses model default"
        default 0
        range 0 99

endmenu
```
