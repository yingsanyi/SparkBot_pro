/* Generated by tools/generate_assets.ps1. */
static const uint64_t s_color_name_glyph_rows[COLOR_NAME_GLYPH_COUNT][COLOR_NAME_GLYPH_SIZE] = {
    { /* red */
        0x0070000000ULL,
        0x0060000000ULL,
        0x00E1FFFFE0ULL,
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        0x0000000000ULL,
    },
    { /* green */
        0x0040000000ULL,
        0x00E0000000ULL,
        0x00C1FFFF80ULL,
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        0x0000000000ULL,
    },
    { /* blue */
        0x000C018000ULL,
        0x000C018000ULL,
        0x1FFFFFFFE0ULL,
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        0x0000000000ULL,
    },
    { /* yellow */
        0x000C00C000ULL,
        0x000C00C000ULL,
        0x000C00C000ULL,
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        0x0000000000ULL,
    },
    { /* purple */
        0x000C060000ULL,
        0x000C060100ULL,
        0x000C060780ULL,
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        0x0000000000ULL,
    },
    { /* color */
        0x0004000000ULL,
        0x000E000000ULL,
        0x001C000000ULL,
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        0x0000000000ULL,
    },
};
