## sparkbot_web_car_control/main/Kconfig.projbuild
```kconfig
menu "SparkBot Web Car Control"

    config SPARKBOT_WEB_CAR_AP_SSID_PREFIX
        string "SoftAP SSID prefix"
        default "SparkBot-Car"
        help
            The final SSID appends the full SoftAP MAC address,
            for example SparkBot-Car-AABBCCDDEEFF.

    config SPARKBOT_WEB_CAR_AP_PASSWORD
        string "SoftAP password"
        default "12345678"
        help
            Leave empty for an open AP. Use at least 8 characters when a
            password is configured.

    config SPARKBOT_WEB_CAR_AP_CHANNEL
        int "SoftAP channel"
        default 6
        range 1 13

    config SPARKBOT_WEB_CAR_HTTP_PORT
        int "HTTP server port"
        default 80
        range 1 65535

    config SPARKBOT_WEB_CAR_COMMAND_PERIOD_MS
        int "Motion command repeat period in ms"
        default 100
        range 50 500
        help
            While the car is moving, the head controller repeats the current
            motion command periodically.

    config SPARKBOT_WEB_CAR_DEADMAN_MS
        int "Motion command timeout in ms"
        default 650
        range 200 3000
        help
            If no new motion command arrives in this time window, the head
            controller sends x0 y0 to stop the chassis.

endmenu
```

## sparkbot_web_car_control/sdkconfig.defaults
```kconfig
CONFIG_IDF_TARGET="esp32s3"
CONFIG_ESPTOOLPY_FLASHMODE_DIO=y
CONFIG_ESPTOOLPY_FLASHFREQ_80M=y
CONFIG_ESPTOOLPY_FLASHSIZE_16MB=y

CONFIG_SPIRAM=y
CONFIG_SPIRAM_MODE_OCT=y
CONFIG_SPIRAM_SPEED_80M=y
CONFIG_SPIRAM_FETCH_INSTRUCTIONS=y
CONFIG_SPIRAM_RODATA=y
CONFIG_SPIRAM_MALLOC_ALWAYSINTERNAL=64

CONFIG_ESP_DEFAULT_CPU_FREQ_MHZ_240=y
CONFIG_FREERTOS_HZ=1000
CONFIG_FREERTOS_TIMER_TASK_STACK_DEPTH=4096
CONFIG_LIBC_NEWLIB_NANO_FORMAT=y

CONFIG_ESP_WIFI_SOFTAP_SUPPORT=y
CONFIG_HTTPD_WS_SUPPORT=y
CONFIG_HTTPD_MAX_URI_LEN=512
CONFIG_HTTPD_MAX_REQ_HDR_LEN=1024

CONFIG_ESP_CONSOLE_USB_SERIAL_JTAG=y
# CONFIG_ESP_CONSOLE_UART_DEFAULT is not set
# CONFIG_ESP_CONSOLE_SECONDARY_USB_SERIAL_JTAG is not set
```

## speaker_hello/main/Kconfig.projbuild
```kconfig
menu "Speaker Hello Configuration"

    config SPEAKER_HELLO_VOLUME
        int "Speaker volume"
        range 0 100
        default 75
        help
            Output volume passed to esp_codec_dev_set_out_vol().

    config SPEAKER_HELLO_REPEAT_DELAY_MS
        int "Repeat delay in ms"
        range 0 3600000
        default 3000
        help
            Delay before replaying the embedded "ni hao" WAV. Set to 0 to play once.

    config SPARKBOT_AUDIO_I2C_NUM
        int "Audio I2C port"
        range 0 1
        default 0
        help
            I2C controller used to configure the ES8311 codec.

    config SPARKBOT_AUDIO_I2S_NUM
        int "Audio I2S port"
        range 0 1
        default 0
        help
            I2S controller used to send PCM samples to the ES8311 codec.

endmenu
```

## speaker_hello/sdkconfig.defaults
```kconfig
CONFIG_SPEAKER_HELLO_VOLUME=75
CONFIG_SPEAKER_HELLO_REPEAT_DELAY_MS=3000
CONFIG_SPARKBOT_AUDIO_I2C_NUM=0
CONFIG_SPARKBOT_AUDIO_I2S_NUM=0
```

## speaker_record_playback/main/Kconfig.projbuild
```kconfig
menu "Speaker Record Playback Configuration"

    config RECORD_PLAYBACK_VOLUME
        int "Speaker volume"
        range 0 100
        default 80
        help
            Output volume used for prompts and recorded audio playback.

    config RECORD_PLAYBACK_SECONDS
        int "Recording duration in seconds"
        range 1 15
        default 5
        help
            Fixed duration for recording human voice.

    config RECORD_PLAYBACK_MIC_GAIN_DB
        int "Microphone gain in dB"
        range 0 45
        default 35
        help
            Input gain passed to esp_codec_dev_set_in_gain().

    config SPARKBOT_AUDIO_I2C_NUM
        int "Audio I2C port"
        range 0 1
        default 0
        help
            I2C controller used to configure the ES8311 codec.

    config SPARKBOT_AUDIO_I2S_NUM
        int "Audio I2S port"
        range 0 1
        default 0
        help
            I2S controller used by ES8311 playback and recording.

endmenu
```

## speaker_record_playback/sdkconfig.defaults
```kconfig
CONFIG_RECORD_PLAYBACK_VOLUME=80
CONFIG_RECORD_PLAYBACK_SECONDS=5
CONFIG_RECORD_PLAYBACK_MIC_GAIN_DB=35
CONFIG_SPARKBOT_AUDIO_I2C_NUM=0
CONFIG_SPARKBOT_AUDIO_I2S_NUM=0
```

## tank/sparkbot_motion_control/components/baidu/Kconfig
```kconfig
menu "Baidu services"

    config BAIDU_ERNIEBOT_ACCESS_TOKEN
        string "ERNIE Bot access token"
        default ""
        help
            Access token used by the Baidu ERNIE Bot chat endpoint.
            Keep this empty in source control and configure it locally.

    config BAIDU_VOICE_ACCESS_TOKEN
        string "Voice service access token"
        default ""
        help
            Access token used by Baidu speech-to-text and text-to-speech endpoints.
            Keep this empty in source control and configure it locally.

    config BAIDU_ASR_CUID
        string "Speech-to-text CUID"
        default "esp_sparkbot"

    config BAIDU_TTS_CUID
        string "Text-to-speech CUID"
        default "esp_sparkbot"

endmenu
```
